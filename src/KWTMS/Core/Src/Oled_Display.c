#include "oled_display.h"
#include "mode.h"
#include <stdint.h>
#include <string.h>
#include <stdio.h>
char scrollText[] = "HIXAA Technologies Pvt. Ltd. | www.hixaa.com | +919372429144 ";
int scrollX = 128;

const uint8_t font5x7[][5] = {

// space
{0x00,0x00,0x00,0x00,0x00},

// numbers
{0x3E,0x51,0x49,0x45,0x3E}, // 0
{0x00,0x42,0x7F,0x40,0x00}, // 1
{0x42,0x61,0x51,0x49,0x46}, // 2
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{0x06,0x49,0x49,0x29,0x1E}, // 9

// A-Z
{0x7E,0x11,0x11,0x11,0x7E}, // A
{0x7F,0x49,0x49,0x49,0x36}, // B
{0x3E,0x41,0x41,0x41,0x22}, // C
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{0x61,0x51,0x49,0x45,0x43}, // Z

// symbols
{0x00,0x00,0x7F,0x00,0x00}, // |
{0x00,0x60,0x60,0x00,0x00}, // .
{0x08,0x08,0x3E,0x08,0x08}  // +

};



#define OLED_ADDR 0x78   // 0x3C << 1

extern I2C_HandleTypeDef hi2c1;

void SSD1306_WriteCommand(uint8_t cmd);
void SSD1306_WriteData(uint8_t *data, uint16_t size);
void SSD1306_Init(void);
void SSD1306_DisplayImage(const uint8_t *img);

const uint8_t image[1024] = {
   // PASTE YOUR FULL 1024 BYTES HERE
		0xff, 0xff, 0xff, 0xff, 0xff, 0xff, 0xff, 0xff, 0xff, 0xff, 0xff, 0xff, 0xff, 0xff, 0xff, 0xff,
		0xff, 0xff, 0xff, 0xff, 0xff, 0xff, 0xff, 0xff, 0xff, 0xff, 0xff, 0xff, 0xff, 0xff, 0xff, 0xff,
		0xff, 0xff, 0xff, 0xff, 0xff, 0xff, 0xff, 0xff, 0xff, 0xff, 0xff, 0xff, 0xff, 0xff, 0xff, 0xff,
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		0xff, 0xff, 0xff, 0xff, 0xff, 0xff, 0xff, 0xff, 0xff, 0xff, 0xff, 0xff, 0xff, 0xff, 0xff, 0xff
};
void SSD1306_WriteCommand(uint8_t cmd)
{
    uint8_t data[2];
    data[0] = 0x00;
    data[1] = cmd;
    HAL_I2C_Master_Transmit(&hi2c1, OLED_ADDR, data, 2, 100);
}
void SSD1306_WriteData(uint8_t *data, uint16_t size)
{
    uint8_t buffer[129];
    buffer[0] = 0x40;

    for(uint16_t i = 0; i < size; i++)
    {
        buffer[i+1] = data[i];
    }

    HAL_I2C_Master_Transmit(&hi2c1, OLED_ADDR, buffer, size+1, 100);
}
void SSD1306_Init(void)
{
    HAL_Delay(100);

    SSD1306_WriteCommand(0xAE);
    SSD1306_WriteCommand(0x20);
    SSD1306_WriteCommand(0x10);
    SSD1306_WriteCommand(0xB0);
    SSD1306_WriteCommand(0xC8);
    SSD1306_WriteCommand(0x00);
    SSD1306_WriteCommand(0x10);
    SSD1306_WriteCommand(0x40);
    SSD1306_WriteCommand(0x81);
    SSD1306_WriteCommand(0xFF);
    SSD1306_WriteCommand(0xA1);
    SSD1306_WriteCommand(0xA6);
    SSD1306_WriteCommand(0xA8);
    SSD1306_WriteCommand(0x3F);
    SSD1306_WriteCommand(0xA4);
    SSD1306_WriteCommand(0xD3);
    SSD1306_WriteCommand(0x00);
    SSD1306_WriteCommand(0xD5);
    SSD1306_WriteCommand(0xF0);
    SSD1306_WriteCommand(0xD9);
    SSD1306_WriteCommand(0x22);
    SSD1306_WriteCommand(0xDA);
    SSD1306_WriteCommand(0x12);
    SSD1306_WriteCommand(0xDB);
    SSD1306_WriteCommand(0x20);
    SSD1306_WriteCommand(0x8D);
    SSD1306_WriteCommand(0x14);
    SSD1306_WriteCommand(0xAF);
}

void SSD1306_DisplayImage(const uint8_t *img)
{
    for(uint8_t page = 0; page < 8; page++)
    {
        SSD1306_WriteCommand(0xB0 + page);
        SSD1306_WriteCommand(0x00);
        SSD1306_WriteCommand(0x10);

        SSD1306_WriteData((uint8_t*)&img[page * 128], 128);
    }
}
void SSD1306_Clear(void)
{
    uint8_t clear[128];
    for(int i=0;i<128;i++) clear[i]=0x00;

    for(uint8_t page=0; page<8; page++)
    {
        SSD1306_WriteCommand(0xB0 + page);
        SSD1306_WriteCommand(0x00);
        SSD1306_WriteCommand(0x10);

        SSD1306_WriteData(clear,128);
    }
}
void SSD1306_StartScroll(void)
{
    SSD1306_WriteCommand(0x2E); // stop scroll first

    SSD1306_WriteCommand(0x26); // horizontal scroll right
    SSD1306_WriteCommand(0x00);
    SSD1306_WriteCommand(0x00); // start page = 0
    SSD1306_WriteCommand(0x00); // speed
    SSD1306_WriteCommand(0x07); // end page = 7
    SSD1306_WriteCommand(0x00);
    SSD1306_WriteCommand(0xFF);

    SSD1306_WriteCommand(0x2F); // activate scroll
}
void SSD1306_DisplayMAC(void)
{

    uint8_t buffer[128];
    memset(buffer,0,128);

    char text1[] = "MAC ID:";
    char text2[] = "AA:BB:CC:DD:EE:FF";

    int len = strlen(text1);

    for(int i=0;i<len;i++)
    {
        char c = text1[i];
        int index = -1;

        if(c==' ') index=0;
        else if(c>='A' && c<='Z') index=(c-'A')+11;

        int pos = 10 + (i*11);

        if(index>=0)
        {
        	for(int j=0;j<5;j++)
        	{
        	    buffer[pos+(j*2)] = font5x7[index][j];
        	    buffer[pos+(j*2)+1] = font5x7[index][j];
        	}
        }
    }

    SSD1306_WriteCommand(0xB2);
    SSD1306_WriteCommand(0x00);
    SSD1306_WriteCommand(0x10);
    SSD1306_WriteData(buffer,128);
}
void SSD1306_DrawScrollingText(void)
{
    uint8_t line[128];
    uint8_t buffer[128];

    for(int i=0;i<128;i++)
    {
        line[i] = 0x60;     // horizontal separator
        buffer[i] = 0x00;
    }

    int len = strlen(scrollText);

    for(int i=0;i<len;i++)
    {
        char c = scrollText[i];
        int index = -1;

        if(c==' ')
            index = 0;
        else if(c>='0' && c<='9')
            index = (c-'0') + 1;
        else if(c>='A' && c<='Z')
            index = (c-'A') + 11;
        else if(c>='a' && c<='z')
            index = (c-'a') + 11;
        else if(c=='|')
            index = 37;
        else if(c=='.')
            index = 38;
        else if(c=='+')
            index = 39;

        int pos = scrollX + (i*6);

        if(index >= 0 && index < (sizeof(font5x7)/sizeof(font5x7[0])))
        {
            for(int j=0;j<5;j++)
            {
                int drawPos = pos + j;

                if(drawPos >=0 && drawPos <128)
                {
                	buffer[drawPos] = font5x7[index][j];

                	if(drawPos+1 < 128)
                	{
                	    buffer[drawPos+1] = font5x7[index][j];
                	}
                }
            }
        }
    }

    // draw separator line
    SSD1306_WriteCommand(0xB6);
    SSD1306_WriteCommand(0x00);
    SSD1306_WriteCommand(0x10);
    SSD1306_WriteData(line,128);

    // draw scrolling text
    SSD1306_WriteCommand(0xB7);
    SSD1306_WriteCommand(0x00);
    SSD1306_WriteCommand(0x10);
    SSD1306_WriteData(buffer,128);

    scrollX--;

    if(scrollX < -(len*6))
        scrollX = 128;
}
void ScrollTextInit(void)
{
    SSD1306_WriteCommand(0xB7); // page 7 (bottom area)
    SSD1306_WriteCommand(0x00);
    SSD1306_WriteCommand(0x10);
}
void SSD1306_DisplayTemperature(float temp)
{
    uint8_t buffer1[128];
    uint8_t buffer2[128];

    memset(buffer1,0,128);
    memset(buffer2,0,128);

    char title[] = "TEMPERATURE";

    int t1 = (int)temp;
    int t2 = (int)((temp - t1)*100);

    char value[20];
    sprintf(value,"%d.%02d C",t1-4,t2-4);

    int len1 = strlen(title);

    for(int i=0;i<len1;i++)
    {
        char c = title[i];
        int index = -1;

        if(c==' ') index=0;
        else if(c>='A' && c<='Z') index=(c-'A')+11;

        int pos = 10 + (i*11);

        if(index>=0)
        {
        	for(int j=0;j<5;j++)
        	{
        	    buffer1[pos+(j*2)] = font5x7[index][j];
        	    buffer1[pos+(j*2)+1] = font5x7[index][j];
        	}
        }
    }

    int len2 = strlen(value);

    for(int i=0;i<len2;i++)
    {
        char c = value[i];
        int index = -1;

        if(c==' ') index=0;
        else if(c>='0' && c<='9') index=(c-'0')+1;
        else if(c=='.') index=38;
        else if(c=='C') index=('C'-'A')+11;

        int pos = 35 + (i*11);

        if(index>=0)
        {
        	for(int j=0;j<5;j++)
        	{
        	    buffer2[pos+(j*2)] = font5x7[index][j];
        	    buffer2[pos+(j*2)+1] = font5x7[index][j];
        	}
        }
    }

    /* title */
    SSD1306_WriteCommand(0xB2);
    SSD1306_WriteCommand(0x00);
    SSD1306_WriteCommand(0x10);
    SSD1306_WriteData(buffer1,128);

    /* temperature value */
    SSD1306_WriteCommand(0xB4);
    SSD1306_WriteCommand(0x00);
    SSD1306_WriteCommand(0x10);
    SSD1306_WriteData(buffer2,128);
}
